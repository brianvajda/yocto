## meta-mandrake-one/conf/layer.conf
```bitbake
# We have a conf and classes directory, add to BBPATH
BBPATH .= ":${LAYERDIR}"

# We have recipes-* directories, add to BBFILES
BBFILES += "${LAYERDIR}/recipes-*/*/*.bb \
            ${LAYERDIR}/recipes-*/*/*.bbappend"

BBFILE_COLLECTIONS += "meta-mandrake-one"
BBFILE_PATTERN_meta-mandrake-one = "^${LAYERDIR}/"
BBFILE_PRIORITY_meta-mandrake-one = "3"

LAYERSERIES_COMPAT_meta-mandrake-one = "sumo thud warrior zeus"
LAYERDEPENDS_meta-mandrake-one = "core"
```
